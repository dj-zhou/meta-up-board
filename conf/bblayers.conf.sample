## conf/bblayers.conf.sample
```bitbake
# POKY_BBLAYERS_CONF_VERSION is increased each time build/conf/bblayers.conf
# changes incompatibly
POKY_BBLAYERS_CONF_VERSION = "2"

BBPATH = "${TOPDIR}"
BSPDIR := "${@os.path.abspath(os.path.dirname(d.getVar('FILE', True)) +  '/../..')}"
BBFILES ?= ""

BBLAYERS ?= " \
  ${BSPDIR}/poky/meta \
  ${BSPDIR}/poky/meta-poky \
  ${BSPDIR}/poky/meta-yocto-bsp \
  ${BSPDIR}/meta-intel\
  ${BSPDIR}/meta-up-board \
  ${BSPDIR}/meta-openembedded/meta-oe \
  ${BSPDIR}/meta-openembedded/meta-python \
  ${BSPDIR}/meta-openembedded/meta-multimedia \
  ${BSPDIR}/meta-openembedded/meta-networking \
  ${BSPDIR}/meta-openembedded/meta-filesystems \
  "

# ${BSPDIR}/meta-virtualization
```

## conf/local.conf.sample
```bitbake
MACHINE ?= "up-board"

DL_DIR ?= "${HOME}/soft/yocto-shared-download"
SSTATE_DIR ?= "${HOME}/soft/yocto-shared-sstate-cache"
DISTRO ?= "poky"
PACKAGE_CLASSES ?= "package_rpm"
EXTRA_IMAGE_FEATURES ?= "debug-tweaks"
USER_CLASSES ?= "buildstats image-mklibs image-prelink"
PATCHRESOLVE = "noop"

BB_DISKMON_DIRS = "\
    STOPTASKS,${TMPDIR},1G,100K \
    STOPTASKS,${DL_DIR},1G,100K \
    STOPTASKS,${SSTATE_DIR},1G,100K \
    STOPTASKS,/tmp,100M,100K \
    ABORT,${TMPDIR},100M,1K \
    ABORT,${DL_DIR},100M,1K \
    ABORT,${SSTATE_DIR},100M,1K \
    ABORT,/tmp,10M,1K"

PACKAGECONFIG_append_pn-qemu-native = " sdl"
PACKAGECONFIG_append_pn-nativesdk-qemu = " sdl"

CONF_VERSION = "1"

# Include SystemD and SystemCTL
DISTRO_FEATURES_append = " systemd"
VIRTUAL-RUNTIME_init_manager = "systemd"
VIRTUAL-RUNTIME_initscripts = "systemd-compat-units"
DISTRO_FEATURES_BACKFILL_CONSIDERED = "sysvinit"

PREFERRED_PROVIDER_iasl-native = "acpica-native"

# virtualization (try this part) 
# DISTRO_FEATURES_append = "virtualization"
# IMAGE_INSTALL_append = "docker python3-docker-compose"

# UP specific settings, where is it used?
UP_SECURE_BOOT = "0"

# build history ----------------
INHERIT += "buildhistory"
BUILDHISTORY_COMMIT = "1"
BUILDHISTORY_FEATURES = "image"
# BUILDHISTORY_IMAGE_FILES += "/path/to/file
# just added so buildhistory is happy
PRSERV_HOST = "localhost:0"

# build statistics ----------------
# set in USER_CLASSES
BUILDSTATS_BASE = "${TOPDIR}/build-stats"
```
